/ {
	#address-cells = <2>;
	#size-cells = <2>;

	soc {
		compatible = "simple-bus";
		#address-cells = <2>;
		#size-cells = <2>;
		ranges;

		uart3: serial@6430000 {
			compatible = "snps,dw-apb-uart";
			reg = <0x0 0x6430000 0x0 0x100>;
			reg-shift = <2>;
			reg-io-width = <4>;
			clock-frequency = <40000000>;
			status = "disabled";
		};

		mmc1: mmc@a000000 {
			compatible = "snps,dw-mshci";
			reg = <0x0 0x0a000000 0x0 0x00100000>;
			/* Ignore the controller's clock-multiplier capability. */
			sdhci-caps-mask = <0x00ff0000 0x00000000>;
			status = "disabled";
		};
	};
};
